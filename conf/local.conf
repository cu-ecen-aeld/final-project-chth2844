## conf/local.conf
```bitbake
MACHINE = "raspberrypi4"
DISTRO_FEATURES:append = "wifi"
IMAGE_INSTALL:append = "linux-firmware-rpidistro-bcm43430 v4l-utils python3 ntp wpa-supplicant libgpiod libgpiod-tools libgpiod-dev"
IMAGE_FEATURES += "ssh-server-openssh"
IMAGE_FSTYPES = "wic.bz2"
GPU_MEM = "16"
```

## meta-fps/conf/layer.conf
```bitbake
# We have a conf and classes directory, add to BBPATH 
BBPATH := "${BBPATH}:${LAYERDIR}" 

# We have a packages directory, add to BBFILES 
BBFILES := "${BBFILES} ${LAYERDIR}/recipes-*/*/*.bb \ 
            ${LAYERDIR}/recipes-*/*/*.bbappend" 

LAYERSERIES_COMPAT_meta-fps = "honister"

BBFILE_COLLECTIONS += "meta-fps" 
BBFILE_PATTERN_meta-fps:= "^${LAYERDIR}/" 
BBFILE_PRIORITY_meta-fps:= "6"

LAYERDEPENDS_fps= "core"
```

## meta-server/conf/layer.conf
```bitbake
# We have a conf and classes directory, add to BBPATH 
BBPATH := "${BBPATH}:${LAYERDIR}" 

# We have a packages directory, add to BBFILES 
BBFILES := "${BBFILES} ${LAYERDIR}/recipes-*/*/*.bb \ 
            ${LAYERDIR}/recipes-*/*/*.bbappend" 

LAYERSERIES_COMPAT_meta-server = "honister"

BBFILE_COLLECTIONS += "meta-server" 
BBFILE_PATTERN_meta-server:= "^${LAYERDIR}/" 
BBFILE_PRIORITY_meta-server:= "6"

LAYERDEPENDS_server= "core"
```

## meta-uart/conf/layer.conf
```bitbake
# We have a conf and classes directory, add to BBPATH 
BBPATH := "${BBPATH}:${LAYERDIR}" 

# We have a packages directory, add to BBFILES 
BBFILES := "${BBFILES} ${LAYERDIR}/recipes-*/*/*.bb \ 
            ${LAYERDIR}/recipes-*/*/*.bbappend" 

LAYERSERIES_COMPAT_meta-uart = "honister"

BBFILE_COLLECTIONS += "meta-uart" 
BBFILE_PATTERN_meta-uart:= "^${LAYERDIR}/" 
BBFILE_PRIORITY_meta-uart:= "6"

LAYERDEPENDS_uart= "core"
```
